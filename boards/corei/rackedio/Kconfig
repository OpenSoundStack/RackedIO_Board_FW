## boards/corei/rackedio/Kconfig.defconfig
```kconfig
if BOARD_RACKEDIO

configdefault NET_L2_ETHERNET
	default y

config NUM_IRQS
    default 255

endif
```

## boards/corei/rackedio/board.yml
```yaml
board:
  name: rackedio
  full_name: Core I Racked IO
  vendor: osst
  socs:
    - name: stm32h723xx
```

## boards/corei/rackedio/dts/bindings/preamp.yml
```yaml
compatible: "preamp"
description: Preamp Control Node

child-binding:
  description: Core I Racked IO Preamp Control node
  properties:
    b0:
      type: phandle-array
      specifier-space: gpio
      required: true
      description: Gain control bit 0
    b1:
      type: phandle-array
      specifier-space: gpio
      required: true
      description: Gain control bit 1
    phantom:
      type: phandle-array
      specifier-space: gpio
      required: true
      description: Phantom Power supply enable
```
